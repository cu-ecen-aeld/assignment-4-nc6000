## base_external/Config.in
```kconfig
menu "AESD assignments"

    source "package/aesd-assignments/Config.in"

endmenu
```

## base_external/package/aesd-assignments/Config.in
```kconfig
config BR2_PACKAGE_AESD_ASSIGNMENTS
    bool "aesd-assignments"
    help
      Install aesd-assignments from your repository
      
config BR2_PACKAGE_FINDER_APP
    bool "finder-app"
    help
      Installs the finder-app directory and scripts to the target.
```

## base_external/package/aesd-assignments/base_external/package/aesd-assignments/Config.in
```kconfig
config BR2_PACKAGE_AESD_ASSIGNMENTS
    bool "aesd-assignments"
    help
      Custom package for aesd assignments including writer, finder and tester scripts.
```
